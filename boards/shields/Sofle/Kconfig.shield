## boards/shields/Sofle/Kconfig.shield
```kconfig
# Copyright (c) 2020 Pete Johanson
# SPDX-License-Identifier: MIT

config SHIELD_SOFLE_LEFT
    def_bool $(shields_list_contains,Sofle_left)

config SHIELD_SOFLE_RIGHT
    def_bool $(shields_list_contains,Sofle_right)
```
